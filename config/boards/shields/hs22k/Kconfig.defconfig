## config/boards/shields/hs22k/Kconfig.defconfig
```kconfig
# Copyright (c) 2022 Daniel Grenehed
# SPDX-License-Identifier: MIT

if BOARD_HS22K

config ZMK_KEYBOARD_NAME
	default "HS22K"

endif # BOARD_HS22K
```

## config/boards/shields/hs22k/Kconfig.shield
```kconfig
# Copyright (c) 2022 Daniel Grenehed
# SPDX-License-Identifier: MIT

config SHIELD_HS22K
	def_bool $(shields_list_contains,hs22k)
```
