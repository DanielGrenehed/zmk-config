## config/boards/shields/s22k/Kconfig.shield
```kconfig
CONFIG_ZMK_COMBO_MAX_PRESSED_COMBOS=6
COMFIG_ZMK_COMBO_MAX_COMBOS_PER_KEY=10
CONFIG_ZMK_COMBO_MAX_KEYS_PER_COMBO=6
config SHIELD_S22K_LEFT
    def_bool $(shields_list_contains,s22k_left)

config SHIELD_S22K_RIGHT
    def_bool $(shields_list_contains,s22k_right)
```
